## boards/shields/cornev5/Kconfig
```kconfig
# SPDX-License-Identifier: MIT

source "Kconfig.board"
source "Kconfig.defconfig"

config BOARD_ENABLE_DCDC
    bool "Enable DCDC mode"
    select SOC_DCDC_NRF52X
    default n
    depends on ( BOARD_CORNEV5_LEFT || BOARD_CORNEV5_RIGHT ) && SOC_SERIES_NRF52X

config BOARD_CORNEV5_CHARGER
    bool "Enable battery charger"
    default y
    depends on ( BOARD_CORNEV5_LEFT || BOARD_CORNEV5_RIGHT )
```

## boards/shields/cornev5/Kconfig.board
```kconfig
# SPDX-License-Identifier: MIT

config BOARD_CORNEV5_LEFT
	bool "Corne v5 Left"
	depends on SOC_NRF52840_QIAA

config BOARD_CORNEV5_RIGHT
	bool "Corne v5 Right"
	depends on SOC_NRF52840_QIAA
```

## boards/shields/cornev5/Kconfig.defconfig
```kconfig
if SHIELD_CORNEV5_LEFT

config ZMK_KEYBOARD_NAME
    default "Corne Rev5"

config ZMK_SPLIT_ROLE_CENTRAL
    default y

endif

if SHIELD_CORNEV5_LEFT || SHIELD_CORNEV5_RIGHT

config ZMK_SPLIT
    default y

endif
```

## boards/shields/cornev5/Kconfig.shield
```kconfig
config SHIELD_CORNEV5_LEFT
    def_bool $(shields_list_contains,cornev5_left)

config SHIELD_CORNEV5_RIGHT
    def_bool $(shields_list_contains,cornev5_right)
```

## boards/shields/cornev5/board.yml
```yaml
boards:
  - name: cornev5_left
    socs:
      - name: nrf52840
  - name: cornev5_right
    socs:
      - name: nrf52840
```
